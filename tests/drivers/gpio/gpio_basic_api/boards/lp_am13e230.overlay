/*
 * Copyright (c) 2026 Texas Instruments
 *
 * SPDX-License-Identifier: Apache-2.0
 */

/*
 * GPIO loopback test resources for LP-AM13E230.
 * Jumper PA8 (out-gpios) to PA9 (in-gpios) for the runtime loopback test.
 */

/ {
	resources {
		compatible = "test-gpio-basic-api";
		out-gpios = <&gpioa 8 GPIO_ACTIVE_HIGH>; /* PA8 */
		in-gpios  = <&gpioa 9 GPIO_ACTIVE_HIGH>; /* PA9 */
	};
};
