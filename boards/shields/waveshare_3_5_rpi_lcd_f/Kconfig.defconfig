## boards/shields/waveshare_3_5_tft_touch/Kconfig.defconfig
```kconfig
# Copyright (c) 2026 Texas Instruments
# SPDX-License-Identifier: Apache-2.0

if SHIELD_WAVESHARE_3_5_TFT_TOUCH

if DISPLAY

if LVGL

config LV_Z_VDB_SIZE
	default 32

choice LV_COLOR_DEPTH
	default LV_COLOR_DEPTH_16
endchoice

config INPUT
	default y

config LV_Z_POINTER_INPUT
	default y

endif # LVGL

endif # DISPLAY

endif # SHIELD_WAVESHARE_3_5_TFT_TOUCH
```

## boards/shields/waveshare_3_5_tft_touch/Kconfig.shield
```kconfig
# Copyright (c) 2026 Texas Instruments
# SPDX-License-Identifier: Apache-2.0

config SHIELD_WAVESHARE_3_5_TFT_TOUCH
	def_bool $(shields_list_contains,waveshare_3_5_tft_touch)
```

## drivers/fuel_gauge/bq27z8xx/Kconfig
```kconfig
# Copyright (c) 2023, ithinx GmbH
# Copyright (c) 2023, Tonies GmbH
# Copyright (c) 2026, Texas Instruments Incorporated
#
# SPDX-License-Identifier: Apache-2.0

config BQ27Z8XX_COMMON
	bool
	select I2C
	help
	  Hidden symbol — selected automatically by BQ27Z758 or BQ27Z855.
	  Enables the shared transport, MAC protocol, and common property handling
	  for TI BQ27Z8xx family fuel gauges.

config BQ27Z758
	bool "TI BQ27Z758 fuel gauge"
	default y
	depends on DT_HAS_TI_BQ27Z758_ENABLED
	select BQ27Z8XX_COMMON
	help
	  Enable driver for the TI BQ27Z758 fuel gauge.

config BQ27Z855
	bool "TI BQ27Z855 fuel gauge"
	default y
	depends on DT_HAS_TI_BQ27Z855_ENABLED
	select BQ27Z8XX_COMMON
	help
	  Enable driver for the TI BQ27Z855 fuel gauge.

config EMUL_BQ27Z8XX
	bool "Emulate BQ27Z8XX fuel gauge"
	default y
	depends on EMUL
	depends on BQ27Z758 || BQ27Z855
	help
	  Provides an I2C emulator for the TI BQ27Z8XX fuel gauge family.
	  The emulated variant matches the DT compatible used (ti,bq27z758 or
	  ti,bq27z855).  Register reads return simple non-zero values; MAC
	  commands return correctly formatted responses with the appropriate
	  payload length and checksum.

config EMUL_BQ27Z758
	bool "Emulate BQ27Z758 fuel gauge (legacy name)"
	default y
	depends on EMUL
	depends on BQ27Z758
	help
	  Equivalent to EMUL_BQ27Z8XX when only a BQ27Z758 is present.
	  Provided for backward compatibility with projects that set
	  CONFIG_EMUL_BQ27Z758=y; both symbols enable the same emulator.

config BQ27Z8XX_SHELL
	bool "Shell commands for BQ27Z8XX fuel gauge"
	depends on BQ27Z758 || BQ27Z855
	depends on SHELL
	help
	  Enable the bq27z8xx shell command set providing status, lifetime data
	  dumps, security state inspection, and security state transitions
	  (seal, unseal, full_access) for the TI BQ27Z8XX fuel gauge family
	  (BQ27Z758 and BQ27Z855).

config BQ27Z758_SHELL
	bool "Shell commands for BQ27Z758 fuel gauge (legacy name)"
	depends on BQ27Z758
	depends on SHELL
	help
	  Equivalent to BQ27Z8XX_SHELL when only a BQ27Z758 is present.
	  Provided for backward compatibility with projects that set
	  CONFIG_BQ27Z758_SHELL=y; both symbols enable the same shell commands.
```

## drivers/i2c/Kconfig.uart_bridge
```kconfig
# SPDX-License-Identifier: Apache-2.0

config I2C_UART_BRIDGE
	bool "UART-to-I2C bridge virtual I2C controller"
	default y
	depends on DT_HAS_UART_I2C_BRIDGE_ENABLED
	select UART_INTERRUPT_DRIVEN
	help
	  Virtual I2C controller that tunnels I2C transactions over a UART
	  link to a fixed-function bridge MCU.
```

## drivers/mspi/Kconfig.ti
```kconfig
# Copyright (c) 2026 Texas Instruments
# SPDX-License-Identifier: Apache-2.0

config MSPI_MSPM33_QSPI
	bool "TI MSPM33 QSPI controller"
	default y
	depends on DT_HAS_TI_MSPM33_QSPI_ENABLED
	select PINCTRL
	select CLOCK_CONTROL
	help
	  Enable the native PIO MSPI driver for the Texas Instruments
	  MSPM33C QSPI peripheral. Transfers are interrupt-driven (IDLE +
	  RX/TX FIFO interrupts); DMA and XIP are not supported.
```

## drivers/spi/Kconfig.mspm0
```kconfig
# Copyright (c) 2026 Linumiz
# SPDX-License-Identifier: Apache-2.0

config SPI_MSPM0
	bool "TI MSPM0 SPI"
	default y
	depends on DT_HAS_TI_MSPM0_SPI_ENABLED
	select USE_MSPM0_DL_SPI
	select PINCTRL
	select GPIO
	help
	 Enable support for TI MSPM0 SPI peripheral.

config SPI_MSPM0_DMA
	bool "TI MSPM0 SPI DMA support"
	default y
	depends on SPI_MSPM0 && DMA_TI_MSPM0
	help
	 Enable DMA-driven TX for write-only SPI transfers (e.g. display).
	 The CPU sleeps during the transfer instead of busy-spinning on the
	 TX FIFO, freeing cycles for LVGL rendering.  Full-duplex transfers
	 always use the polled path.
```

## dts/bindings/fuel-gauge/ti,bq27z758.yaml
```yaml
# Copyright (c) 2023, ithinx GmbH
# Copyright (c) 2023, Tonies GmbH
#
# SPDX-License-Identifier: Apache-2.0

description: |
  Texas Instruments BQ27Z758 fuel gauge. For more info visit
  https://www.ti.com/product/BQ27Z758

compatible: "ti,bq27z758"

include: [i2c-device.yaml, fuel-gauge.yaml]
```

## dts/bindings/fuel-gauge/ti,bq27z855.yaml
```yaml
# Copyright (c) 2023, ithinx GmbH
# Copyright (c) 2023, Tonies GmbH
#
# SPDX-License-Identifier: Apache-2.0

description: |
  Texas Instruments BQ27Z855 fuel gauge. For more info visit
  https://www.ti.com/product/BQ27Z855


compatible: "ti,bq27z855"

include: [i2c-device.yaml, fuel-gauge.yaml]
```

## dts/bindings/i2c/uart-i2c-bridge.yaml
```yaml
# SPDX-License-Identifier: Apache-2.0

description: |
  UART-to-I2C bridge virtual I2C controller.

  Tunnels Zephyr I2C transactions over a UART link to a fixed-function
  bridge MCU running the uart_i2c_bridge firmware (SHared_i2c protocol).


compatible: "uart-i2c-bridge"

include: [i2c-controller.yaml]

properties:
  uart-dev:
    type: phandle
    required: true
    description: UART device connected to the bridge MCU (9600 baud 8N1).

  response-timeout-ms:
    type: int
    default: 100
    description: Milliseconds to wait for read-response bytes from the bridge.
```

## dts/bindings/mspi/ti,mspm33-qspi.yaml
```yaml
# Copyright (c) 2026 Texas Instruments
# SPDX-License-Identifier: Apache-2.0

description: |
  Texas Instruments MSPM33C QSPI controller.

  This binding covers the QSPI peripheral found on the MSPM33C family,
  used as an indirect (PIO) multi-bit SPI controller via the Zephyr
  MSPI subsystem.

compatible: "ti,mspm33-qspi"

include:
  - mspi-controller.yaml
  - pinctrl-device.yaml

properties:
  reg:
    required: true

  interrupts:
    required: true

  clocks:
    required: true
    description: |
      Clock phandle/specifier for the QSPI peripheral clock, e.g.
      <&ckm MSPM0_CLOCK_ULPCLK>.

  pinctrl-0:
    required: true

  pinctrl-names:
    required: true
```

## dts/bindings/spi/ti,mspm0-spi.yaml
```yaml
# Copyright (c) 2026 Linumiz
# SPDX-License-Identifier: Apache-2.0

description: |
   TEXAS INSTRUMENTS MSPM0 SERIAL PERIPHERAL INTERFACE (SPI).

compatible: "ti,mspm0-spi"
include: [spi-controller.yaml, pinctrl-device.yaml]

properties:
  reg:
    required: true

  pinctrl-0:
    required: true

  clocks:
    required: true

  dmas:
    description: |
      Optional TX (and RX) DMA channel specifiers.
      Each entry is <&dma channel trigger> where channel is the DMA channel
      index (0-based) and trigger is the hardware trigger ID (e.g. 13 for
      SPI0 TX, 15 for SPI1 TX on MSPM0G351x).

  dma-names:
    description: |
      DMA channel names.  Use "tx" for the transmit channel and "rx" for
      the receive channel.
```
