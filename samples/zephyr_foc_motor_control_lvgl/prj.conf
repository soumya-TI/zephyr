## CMakeLists.txt
```
# SPDX-License-Identifier: Apache-2.0

cmake_minimum_required(VERSION 3.20.0)

# This sample is built for the Waveshare 3.5" RPi LCD (F) panel, which the
# shield provides (ST7796S display + GT911 touch). Default it so a plain
# "west build -b lp_mspm0g3519 ." works; an explicit --shield still overrides.        zephyr,display = &ssd1306; /* Must point to your active display node label */
if(NOT DEFINED SHIELD)
  set(SHIELD waveshare_3_5_rpi_lcd_f)
endif()

find_package(Zephyr REQUIRED HINTS $ENV{ZEPHYR_BASE})
project(zephyr_foc_motor_control_lvgl)

set(SDK_PATH ../../../modules/hal/ti/am13/ti)
set(DEVICE am13e230x)

if(BOARD_REVISION STREQUAL "e1")
    set(syscfg_gen_path "e1_syscfg_gen_code")
elseif(BOARD_REVISION STREQUAL "e2")
    set(syscfg_gen_path "e2_syscfg_gen_code")
else()
    set(syscfg_gen_path "e2_syscfg_gen_code")
endif()

# ---------------------------------------------------------------------------
# LVGL UI — generated source list and user config (both append to
# LV_EDITOR_PROJECT_SOURCES using ${CMAKE_CURRENT_LIST_DIR}, which resolves
# to ui/ when included from here).
# ---------------------------------------------------------------------------

set(UI_DIR ${CMAKE_CURRENT_SOURCE_DIR}/ui)
include(${UI_DIR}/file_list_gen.cmake)
include(${UI_DIR}/user_config.cmake)

add_subdirectory(realtimelib)

# ---------------------------------------------------------------------------
# Compile definitions
# ---------------------------------------------------------------------------
target_compile_definitions(app PRIVATE
    MOTOR_THREE_SHUNT=1
    BSXL8323RH_REVB=1
    DATALOGF2_EN=1
    LV_LVGL_H_INCLUDE_SIMPLE
)

target_compile_options(app PRIVATE
    -march=armv8.1-m.main+cdecp0
    -Wno-unused
    -Ofast
)

# ---------------------------------------------------------------------------
# Include paths
# ---------------------------------------------------------------------------
target_include_directories(app PUBLIC
    .
    src

    # LVGL UI
    ${UI_DIR}

    # FOC motor control
    motor_control/common/appLib/include
    motor_control/common/hal/controllerInterface/include
    motor_control/common/hal/focInterface/include
    motor_control/common/hal/gateDriverInterface/include

    # AM13 SDK
    ../../../modules/hal/ti/am13/mcu_sdk/source/compiler/m33_ti_arm_clang
    ../../../modules/hal/ti/am13/mcu_sdk/source/device/am13e2x/include
    ../../../modules/hal/ti/am13/mcu_sdk/source/device/am13e2x/include/hw
    ../../../modules/hal/ti/am13/mcu_sdk/ti_sdk_config/am13e2x/default/device_support/include
    ../../../modules/hal/ti/am13/mcu_sdk/source/arch/include
    ../../../modules/hal/ti/am13/mcu_sdk/source/arch/m33/include
    ../../../modules/hal/ti/am13/mcu_sdk/ti_sdk_config/am13e2x/default/arch_cfg
    ../../../modules/hal/ti/am13/mcu_sdk/source/cmsis/Core/Include
    ../../../modules/hal/ti/am13/mcu_sdk/source/cmsis/DSP/Include
    ../../../modules/lib/cmsis-dsp/Include
    ../../../modules/hal/ti/am13/mcu_sdk/source/driverlib/am13e2x
    ../../../modules/hal/ti/am13/mcu_sdk/source/utils/log/include
    ../../../modules/hal/ti/am13/mcu_sdk/ti_sdk_config/am13e2x/default/utils_cfg

    # realtimelib
    realtimelib/control/pi/include
    realtimelib/control/pr/include
    realtimelib/control/ipd/include
    realtimelib/control/dead_time_comp/include
    realtimelib/control/TiTune/include
    realtimelib/control/fwc/include
    realtimelib/control/mtpa/include
    realtimelib/control/vs_freq/include
    realtimelib/control/vsf/include
    realtimelib/control/dclink_ss/include
    realtimelib/filter/filter_fo/include
    realtimelib/observers/est_lib/include
    realtimelib/observers/esmo/include
    realtimelib/observers/speedfr/include
    realtimelib/transforms/clarke/include
    realtimelib/transforms/ipark/include
    realtimelib/transforms/park/include
    realtimelib/transforms/svgen/include
    realtimelib/transforms/volts/include
    realtimelib/utilities/angle_gen/include
    realtimelib/utilities/cpu_time/include
    realtimelib/utilities/datalog/include
    realtimelib/utilities/traj/include
    realtimelib/utilities/types/include
    realtimelib/math/include
    mathlib/fastrts

    motor_control/common/hal/controllerInterface/include
    motor_control/common/hal/focInterface/include
    motor_control/common/hal/gateDriverInterface/DRV8323RH
    motor_control/common/hal/gateDriverInterface/include
    motor_control/common/appLib/include
    motor_control/common/motorConfig/DRV8323_3SH_MTR1

    ${SDK_PATH}/ti_sdk_config/${DEVICE}/default/device_support/include/
    ${SDK_PATH}/ti_sdk_config/${DEVICE}/default/utils_cfg/

    ${SDK_PATH}/source/device/${DEVICE}/include/
    ${SDK_PATH}/source/device/${DEVICE}/include/hw

    ${syscfg_gen_path}
)

# ---------------------------------------------------------------------------
# Sources
# ---------------------------------------------------------------------------
target_sources(app PRIVATE
    src/main.c
    src/foc_display_bridge.c
    isr.c

    # Shell commands
    # shell_commands/cmd_motor.c

    # LVGL UI (generated + custom, excluding motor_sim.c — replaced by bridge)
    ${LV_EDITOR_PROJECT_SOURCES}

    # Syscfg generated peripheral init
    ${syscfg_gen_path}/ti_sdk_dl_config.c

    # realtimelib
    realtimelib/control/pi/source/pi.c
    realtimelib/control/pr/source/pr.c
    realtimelib/control/ipd/source/ipd.c
    realtimelib/control/dead_time_comp/source/dead_time_comp.c
    realtimelib/control/fwc/source/fwc.c
    realtimelib/control/mtpa/source/mtpa.c
    realtimelib/control/vs_freq/source/vs_freq.c
    realtimelib/control/vsf/source/vsf.c
    realtimelib/control/dclink_ss/source/dclink_ss.c

    realtimelib/transforms/clarke/source/clarke.c
    realtimelib/transforms/ipark/source/ipark.c
    realtimelib/transforms/park/source/park.c
    realtimelib/transforms/svgen/source/svgen.c
    realtimelib/transforms/svgen/source/svgen_current.c
    realtimelib/transforms/volts/source/volt_recons.c

    realtimelib/filter/filter_fo/source/filter_fo.c

    realtimelib/observers/esmo/source/esmo.c
    realtimelib/observers/speedfr/source/speedfr.c

    realtimelib/control/TiTune/source/TiTune_Flux.c
    realtimelib/control/TiTune/source/TiTune_J.c
    realtimelib/control/TiTune/source/TiTune_LDQ.c
    realtimelib/control/TiTune/source/TiTune_Rs.c
    realtimelib/control/TiTune/source/TiTune_SatLDQ.c

    realtimelib/utilities/angle_gen/source/angle_gen.c
    realtimelib/utilities/traj/source/traj.c
    realtimelib/utilities/cpu_time/source/cpu_time.c
    realtimelib/utilities/cpu_time/include/cpu_time.h
    realtimelib/utilities/datalog/source/datalogIF.c

    # HAL
    motor_control/common/hal/focInterface/source/hal_3SH_FOCInterface.c
    motor_control/common/hal/focInterface/source/hal_1SH_FOCInterface.c
    motor_control/common/hal/controllerInterface/source/hal.c
    motor_control/common/hal/gateDriverInterface/DRV8323RH/DRV8323RH_Interface.c

    # App lib
    motor_control/common/appLib/source/motor_common.c
    motor_control/common/appLib/source/motor1_init.c
    motor_control/common/appLib/source/Ti_Tune.c
    motor_control/common/appLib/source/application.c
    motor_control/common/motorConfig/DRV8323_3SH_MTR1/drv8323_3SH_motorConfig_M1.c
)
```

## prj.conf
```kconfig
# =============================================================================
# FOC motor control
# =============================================================================
CONFIG_SERIAL=y
CONFIG_MAIN_STACK_SIZE=12228
# Stack sentinel: software canary at the bottom of every stack (no MPU).
# CONFIG_STACK_SENTINEL=y
# CONFIG_THREAD_NAME=y

# =============================================================================
# LVGL + dummy display (no SPI/I2C yet)
# =============================================================================
CONFIG_DISPLAY=y
CONFIG_LVGL=y
CONFIG_INPUT=y
CONFIG_LV_Z_POINTER_INPUT=y

CONFIG_LV_Z_POINTER_INPUT_MSGQ_COUNT=64

CONFIG_INPUT_MODE_SYNCHRONOUS=y

# Widgets used by the motor control UI.
CONFIG_LV_USE_OBSERVER=y
CONFIG_LV_USE_THEME_SIMPLE=y
CONFIG_LV_USE_LABEL=y
CONFIG_LV_USE_IMAGE=y
CONFIG_LV_USE_BUTTON=y
CONFIG_LV_USE_ROLLER=y
CONFIG_LV_USE_CHART=y
CONFIG_LV_USE_TABLE=y
CONFIG_LV_USE_CHECKBOX=y
CONFIG_LV_USE_OBJ_NAME=y

# Built-in fallback font required even though UI ships its own.
CONFIG_LV_FONT_MONTSERRAT_14=y

# AM13E2 is Cortex-M33 with full unaligned-access support, so alignment=1 is
# fine. Keep at 4 to match the vendored UI assets which were compiled with
# this guard set.
CONFIG_LV_COLOR_DEPTH_16=y
CONFIG_LV_ATTRIBUTE_MEM_ALIGN_SIZE=4
CONFIG_HEAP_MEM_POOL_SIZE=4096

# =============================================================================
# Logging — deferred backend so LOG_INF never blocks the calling thread.
# The log thread runs at the lowest priority and only drains the buffer when
# no other thread is runnable.
# =============================================================================
CONFIG_LOG=y
CONFIG_MAIN_THREAD_PRIORITY=1
```

## boards/lp_am13e230.overlay
```dts
/*
 * Copyright (c) 2026 Texas Instruments Incorporated
 * SPDX-License-Identifier: Apache-2.0
 */

/ {
	chosen {
		zephyr,shell-uart = &unicomm4_uart;
	};
};
```

## src/main.c
```c
/*
 * Copyright (c) 2026 Texas Instruments Incorporated
 * SPDX-License-Identifier: Apache-2.0
 *
 * FOC motor control + LVGL motor control UI — integrated application.
 *
 * Thread layout
 * -------------
 *  Priority -1 : Shell (waits for UART input — motor start/stop/set speed)
 *  Priority  0 : do_foc (ISR-driven FOC math + PWM update, ~20 kHz)
 *  Priority  0 : main() (FOC low-priority state machine, ~1 ms)
 *  Priority  5 : lvgl_thread (lv_timer_handler loop, wakes ~100 ms)
 *  Priority 10 : log backend (deferred LOG_INF drain, lowest of all)
 */

#include "user.h"
#include "sys_settings.h"
#include "main.h"

#include "device.h"
#include "log.h"
#include "hal.h"

// #include <zephyr/arch/arch_interface.h>
#include <zephyr/kernel.h>
#include <zephyr/irq.h>
#include <zephyr/shell/shell.h>
#include <zephyr/drivers/display.h>
#include <lvgl.h>

#include "motor_control.h"
#include "ti_sdk_dl_config.h"
#include "foc_display_bridge.h"

#include <zephyr/logging/log.h>
#include <zephyr/sys/printk.h>
LOG_MODULE_REGISTER(app, LOG_LEVEL_INF);

/* ---------------------------------------------------------------------------
 * FOC globals (extern'd by motor library and shell commands)
 * ---------------------------------------------------------------------------*/
SYSTEM_Vars_t systemVars;

/* cmd_motor.c references these for its UART data-streaming plot command.
 * application.c references tx_complete to gate data transmission.
 * uart_transfer.c is not included in this app, so stub them out here. */
bool data_stream = false;
bool data_bin    = false;
bool tx_complete = true;

extern void ADC0_INT1_IRQHandler(void);

/* ---------------------------------------------------------------------------
 * Semaphores
 * ---------------------------------------------------------------------------*/
K_SEM_DEFINE(do_foc_sem, 0, 1);

/* ---------------------------------------------------------------------------
 * do_foc thread — priority 0, ISR-triggered (~20 kHz)
 *
 * Blocks on do_foc_sem. The ADC ISR gives the semaphore once per PWM cycle.
 * application_run() does the full FOC math chain and writes new PWM duties.
 * ---------------------------------------------------------------------------*/
#define FOC_THREAD_STACK_SIZE  4096
K_THREAD_STACK_DEFINE(do_foc_stack, FOC_THREAD_STACK_SIZE);
static struct k_thread foc_thread;

static void do_foc(void *arg1, void *arg2, void *arg3)
{
    ARG_UNUSED(arg1);
    ARG_UNUSED(arg2);
    ARG_UNUSED(arg3);

    printk("Entered do foc loop\n");

    while (1) {
        k_sem_take(&do_foc_sem, K_FOREVER);

        HAL_setGPIOHigh((uint32_t)MTR1_FOC_CTRL_ISR_TIMING_PORT,
                        MTR1_FOC_CTRL_ISR_TIMING_PIN);

        application_run((MOTOR_Handle)&motorVars_M1);

        HAL_setGPIOLow((uint32_t)MTR1_FOC_CTRL_ISR_TIMING_PORT,
                       MTR1_FOC_CTRL_ISR_TIMING_PIN);
    }
}

/* ---------------------------------------------------------------------------
 * main() — FOC low-priority state machine, priority 0, ~1 ms cadence
 *
 * FOC_runLowPriorityStateMachine() handles fault checking, start/stop
 * sequencing, RMS calculation, protection monitors — everything that is
 * correct at 1 ms but does not need the 50 µs ISR cadence.
 * ---------------------------------------------------------------------------*/
int main(void)
{       
    const struct device *display_dev =
        DEVICE_DT_GET(DT_CHOSEN(zephyr_display));

    if (!device_is_ready(display_dev)) {
        printk("Display device not ready — LVGL will not run\n");
        return 0;
    }

    // /* Build every subject, register every observer, load the run screen. */
    motor_control_init("A:");
    foc_display_bridge_init();

    printk("LVGL UI init OK — entering render loop\n");

    /* Render the first frame before turning the display on. */
    lv_timer_handler();

    int ret = display_blanking_off(display_dev);
    if (ret < 0 && ret != -ENOSYS) {
        /* -ENOSYS is expected for the dummy display backend. Any other error
         * is real and worth logging, but not fatal for verification. */
        printk("display_blanking_off returned %d\n", ret);
    }

    SCB->CPACR = 0x00300003;

    SYSCFG_DL_init();

    halHandle = HAL_init(&hal, sizeof(hal));
    HAL_setParams(halHandle);

    initMotor1Handles((MOTOR_Handle)&motorVars_M1);
    initMotor1CtrlParameters((MOTOR_Handle)&motorVars_M1);
    initMotorControlSystem((MOTOR_Handle)&motorVars_M1, &motor1CtrlISR);

    systemVars.flagEnableSystem  = true;
    
    HAL_enableGlobalInts(halHandle);
    
    systemVars.powerRelayWaitTime_ms = POWER_RELAY_WAIT_TIME_ms;

    systemVars.flagEnableSystem  = true;

    systemVars.flagInitializeDone = true;

    initDACOutputs(&systemVars, (MOTOR_Handle)&motorVars_M1);

    IRQ_CONNECT(8, 0, ADC0_INT1_IRQHandler, NULL, 0);

    printk("FOC Motor Control + LVGL starting\n");

    /* Launch do_foc thread (priority 0, FPU registers saved on context switch). */
    k_tid_t foc_tid = k_thread_create(&foc_thread,
        do_foc_stack, FOC_THREAD_STACK_SIZE,
        do_foc, NULL, NULL, NULL,
        0, K_FP_REGS, K_USEC(50));
    k_thread_name_set(foc_tid, "do_foc");

    while (1) {

        uint32_t sleep_ms = lv_timer_handler();

        if (sleep_ms == LV_NO_TIMER_READY) {
            sleep_ms = LV_DEF_REFR_PERIOD;
        }

        uint32_t wallClockMs = 0;

        if (systemVars.flagEnableSystem == true) {

            wallClockMs++;

            if (systemVars.timerCntFOCCtrlISR > LOW_PRIORITY_WAIT_TIME_1ms) {
                systemVars.timerCntFOCCtrlISR = 0;
                wallClockMs = 0;
                FOC_runLowPriorityStateMachine(&motorVars_M1);
            } else if (wallClockMs >= 10u) {
                wallClockMs = 0;
                FOC_runLowPriorityStateMachine(&motorVars_M1);
            }

        }
        k_sleep(K_MSEC(sleep_ms));
    }

    return 0;
}
```

## src/foc_display_bridge.c
```c
/*
 * Copyright (c) 2026 Texas Instruments Incorporated
 * SPDX-License-Identifier: Apache-2.0
 */

#include "foc_display_bridge.h"

#include <zephyr/logging/log.h>
LOG_MODULE_REGISTER(foc_bridge, LOG_LEVEL_INF);

/* LVGL UI API */
#include "motor_control.h"
#include "custom/motor_sim.h"

/* FOC motor data */
#include "motor_common.h"
#include "motor.h"

/* ---------------------------------------------------------------------------
 * External motor state (defined in motor1_init.c / motor_common.c)
 * ---------------------------------------------------------------------------*/
extern MOTOR_Vars_t motorVars_M1;

/* ---------------------------------------------------------------------------
 * Configuration
 * ---------------------------------------------------------------------------*/

/* Motor has 4 pole-pairs: electrical_Hz * 60 / pole_pairs = shaft_RPM */
#define POLE_PAIRS        4

/*
 * Nominal torque used to scale torque_Nm to a 0-100% load percentage.
 * Adjust to match the rated torque of the connected motor.
 */
#define NOMINAL_TORQUE_NM 0.4f

/* Bridge fires every 100 ms — same cadence as the original simulation. */
#define BRIDGE_PERIOD_MS  100

/* Log once per second (every 10 bridge ticks). */
#define LOG_DIVIDER       10

#define RAMP_PER_UNIT    25

#define COAST_PER_TICK   100

#define TEMP_AMBIENT     31
#define TEMP_WARN        80

/* Tenths of a degree of stage heating per tick at full load, and the passive
 * cooling that opposes it. Integer tenths keep the model exact. */
#define HEAT_PER_TICK    3
#define COOL_PER_TICK    1


/* ---------------------------------------------------------------------------
 * UI subject state mirrors
 * ---------------------------------------------------------------------------
 * REF_STATE_* must match the constants in motor_control_gen.h.
 */
#define UI_STATE_STOPPED  0
#define UI_STATE_RUNNING  1
#define UI_STATE_FAULT    2


/*======================= STATIC VARIABLES =======================*/

static uint8_t log_div;

/* Display strings are owned here for the lifetime of the app: lv_subject_copy_string
 * copies into the subject's own buffer, but the subject was declared in XML with
 * a literal, so we always write through the API rather than aliasing. */
static char current_buf[16];
static char bus_buf[16];
static char runtime_buf[16];

/* Stage temperature in TENTHS of a degree, so a slow ramp is representable. The
 * subject carries whole degrees; this is the model's own finer state. */
static int32_t temp_tenths = TEMP_AMBIENT * 10;

/* Session accumulators for the trend screen. */
static int32_t run_ticks;
static int64_t load_sum;
static int32_t load_samples;

/* ---------------------------------------------------------------------------
 * Forward declarations
 * ---------------------------------------------------------------------------*/
static void bridge_tick(lv_timer_t *timer);

/* ---------------------------------------------------------------------------
 * Public API
 * ---------------------------------------------------------------------------*/

 /** Moves `value` toward `target` by at most `step`, without overshooting. */
static int32_t approach(int32_t value, int32_t target, int32_t step)
{
    if(value < target) {
        value += step;
        if(value > target) value = target;
    }
    else if(value > target) {
        value -= step;
        if(value < target) value = target;
    }
    return value;
}

/**
 * Renders thousandths as a one-decimal string: 2400 -> "2.4".
 *
 * This exists because bind_text-fmt has no fixed-point conversion - it forwards
 * to lv_label_set_text_fmt, which on an embedded build has no float support at
 * all. Every decimal in this UI is a pre-formatted string subject for that
 * reason, not because the value is genuinely textual.
 */
static void format_milliamps(char * buf, size_t len, int32_t ma)
{
    if(ma < 0) ma = 0;
    lv_snprintf(buf, len, "%d.%d", (int)(ma / 1000), (int)((ma % 1000) / 100));
}


void foc_display_bridge_init(void)
{
    /* No motor_digits_init() call here. The optimized UI binds subject_rpm_act
     * directly to a label with lv_label_bind_text(..., "%04d") — the old
     * roller-based odometer and its digit-decomposition helper are gone. */
    lv_timer_create(bridge_tick, BRIDGE_PERIOD_MS, NULL);
    printk("FOC display bridge initialised (%d ms period)\n", BRIDGE_PERIOD_MS);
}

/* ---------------------------------------------------------------------------
 * Bridge tick — fires every 100 ms inside lv_timer_handler()
 * ---------------------------------------------------------------------------*/
static void bridge_tick(lv_timer_t *timer)
{
    LV_UNUSED(timer);

    /* ── Direction 1: UI → FOC ──────────────────────────────────────────────
     *
     * Read the subjects that the user modifies through the touchscreen and
     * write the corresponding fields in motorVars_M1 so the FOC loop picks
     * them up on its next 1 ms state-machine tick.
     *
     * subject_state: 0 = stopped, 1 = running, 2 = fault
     * subject_rpm_ref: speed setpoint in RPM (0–3600), set by +/- buttons
     * 
     * 
     */

    int32_t ui_state   = lv_subject_get_int(&subject_state);
    int32_t ui_rpm_ref = lv_subject_get_int(&subject_rpm_ref);
    int32_t ui_rpm_act;
    static int32_t setrpm;
    
    /* ── Speed ────────────────────────────────────────────────────────────
     * Running chases the reference; anything else coasts to rest. Soft start
     * is what the ramp models - with it off the drive steps straight to the
     * commanded speed, which is exactly what that interlock means. */
    if(ui_state == UI_STATE_RUNNING) {
        if(lv_subject_get_int(&subject_cfg_softstart)) {
            int32_t step = lv_subject_get_int(&subject_ramp) * RAMP_PER_UNIT;
            if(step < RAMP_PER_UNIT) step = RAMP_PER_UNIT;
            setrpm = approach(ui_rpm_act, ui_rpm_ref, step);
        }
        else {
            setrpm = ui_rpm_ref;
        }
        run_ticks++;
        
        if(lv_subject_get_int(&subject_cfg_reverse) == 1)
        {
            if(lv_subject_get_int(&subject_dir) == 0){
                motorVars_M1.speedRef_Hz =
                    (float)((setrpm * POLE_PAIRS)/ 60.0f );
            }
            else {
                motorVars_M1.speedRef_Hz =
                    -(float)((setrpm * POLE_PAIRS)/ 60.0f );
            }
        }
        else
        {
            motorVars_M1.speedRef_Hz =
                    (float)((setrpm * POLE_PAIRS)/ 60.0f );
        }
        
        if(motorVars_M1.flagEnableRunAndIdentify != 1)
        {
            motorVars_M1.flagClearFaults = 1;
            motorVars_M1.flagEnableRunAndIdentify =
                        (ui_state == UI_STATE_RUNNING) ? 1 : 0;
        }
        else
        {   
            if (motorVars_M1.faultMtrNow.all != 0)
            {
                lv_subject_set_int(&subject_fault_active, 1);
                lv_subject_set_int(&subject_fault_count, 1);
                lv_subject_set_int(&subject_state, UI_STATE_FAULT);
                motorVars_M1.flagEnableRunAndIdentify = 0;
                
                ui_rpm_act = (float)((motorVars_M1.speed_Hz * 60.0f)/ POLE_PAIRS);
                lv_subject_set_int(&subject_rpm_act, ui_rpm_act);
                
            }
            else
            {
                ui_rpm_act = (float)((motorVars_M1.speed_Hz * 60.0f)/ POLE_PAIRS);
                lv_subject_set_int(&subject_rpm_act, ui_rpm_act);
            }
        }

    }
    else {
        
        //ui_rpm_act = approach(ui_rpm_act, 0, COAST_PER_TICK);                        
        lv_subject_set_int(&subject_rpm_act, 0);
        motorVars_M1.flagEnableRunAndIdentify =
                        (ui_state == UI_STATE_RUNNING) ? 1 : 0;
        if (motorVars_M1.faultMtrNow.all != 0){
            if(lv_subject_get_int(&subject_fault_active)!=0)
            {
                motorVars_M1.flagClearFaults = 1;
            }
        }
    }

    if(ui_rpm_act > lv_subject_get_int(&subject_peak_rpm)) {
        lv_subject_set_int(&subject_peak_rpm, ui_rpm_act);
    }

    /* ── Load and current ─────────────────────────────────────────────────
     * Torque demand rises with speed and with the gap still being closed, so
     * accelerating draws more than holding the same speed - which is what makes
     * the two trend series diverge during a ramp instead of tracking. */
    const int32_t gap  = (ui_rpm_ref > ui_rpm_act) ? (ui_rpm_ref - ui_rpm_act) : 0;
    int32_t load = (ui_rpm_act * 34) / 3600 + (gap * 60) / 3600;
    if(ui_rpm_act == 0) load = 0;
    if(load > 100) load = 100;

    lv_subject_set_int(&subject_load, load);

    /* ~0.9 A at rated load, plus a small no-load draw whenever it is turning. */
    int32_t milliamps = (load * 900) / 100 + (ui_rpm_act > 0 ? 180 : 0);

    const int32_t temp_c = temp_tenths / 10;


    /* ── Thermals ─────────────────────────────────────────────────────────
     * Heating is proportional to load; cooling is constant and always applies,
     * so the stage settles at an equilibrium rather than climbing forever. */
    temp_tenths += (load * HEAT_PER_TICK) / 100 - COOL_PER_TICK;
    if(temp_tenths < TEMP_AMBIENT * 10) temp_tenths = TEMP_AMBIENT * 10;

    /* Thermal derate is an interlock the operator can switch off, so the model
     * has to honour it - an interlock the simulation ignores is a lie in the UI. */
    if(lv_subject_get_int(&subject_cfg_derate) && temp_tenths > TEMP_WARN * 10) {
        milliamps = (milliamps * 70) / 100;
        temp_tenths -= 2;
    }

    lv_subject_set_int(&subject_temp, temp_c);


    /* ── Bus voltage ──────────────────────────────────────────────────────
     * Sags slightly under load; this is what the F311 fault in the log means. */
    const int32_t bus_mv = 2400 - load * 18;
    format_milliamps(bus_buf, sizeof(bus_buf), bus_mv);
    lv_subject_copy_string(&subject_current_str, bus_buf);


    /* ── Session summary for the trend screen ─────────────────────────────── */
    if(ui_state == UI_STATE_RUNNING) {
        load_sum += load;
        load_samples++;
        if(load_samples > 0) {
            lv_subject_set_int(&subject_avg_load, (int32_t)(load_sum / load_samples));
        }

        const int32_t secs = run_ticks / (1000 / BRIDGE_PERIOD_MS);
        lv_snprintf(runtime_buf, sizeof(runtime_buf), "%02d:%02d",
                    (int)(secs / 60), (int)(secs % 60));
        lv_subject_copy_string(&subject_runtime_str, runtime_buf);
    }

}
```

## src/foc_display_bridge.h
```c
/*
 * Copyright (c) 2026 Texas Instruments Incorporated
 * SPDX-License-Identifier: Apache-2.0
 *
 * FOC ↔ LVGL bridge.
 *
 * Replaces motor_sim_init()'s fake simulation timer with a real 100 ms
 * lv_timer_t that:
 *   - reads motorVars_M1 (measured speed, current, torque) and pushes the
 *     values into LVGL subjects via motor_sim_publish(), and
 *   - reads LVGL subjects written by the UI (speed reference, start/stop) and
 *     writes them back into motorVars_M1 so the FOC loop picks them up.
 *
 * Call foc_display_bridge_init() once, after motor_control_init_gen() has
 * registered all subjects but before the first lv_timer_handler() call.
 */

#ifndef FOC_DISPLAY_BRIDGE_H
#define FOC_DISPLAY_BRIDGE_H

void foc_display_bridge_init(void);

#endif /* FOC_DISPLAY_BRIDGE_H */
```
