## CMakeLists.txt
```
# SPDX-License-Identifier: Apache-2.0

cmake_minimum_required(VERSION 3.20.0)

# This sample is built for the Waveshare 3.5" RPi LCD (F) panel, which the
# shield provides (ST7796S display + GT911 touch). Default it so a plain
# "west build -b lp_mspm0g3519 ." works; an explicit --shield still overrides.
if(NOT DEFINED SHIELD)
  set(SHIELD waveshare_3_5_rpi_lcd_f)
endif()

find_package(Zephyr REQUIRED HINTS $ENV{ZEPHYR_BASE})
project(ti_washing_machine)

set(UI_DIR ${CMAKE_CURRENT_SOURCE_DIR}/ui)

# Generated UI source list + hand-written custom sources. Both files append to
# LV_EDITOR_PROJECT_SOURCES using ${CMAKE_CURRENT_LIST_DIR}, which resolves to
# ui/ when included from here.
include(${UI_DIR}/file_list_gen.cmake)
include(${UI_DIR}/user_config.cmake)

target_sources(app PRIVATE
	src/main.c
	${LV_EDITOR_PROJECT_SOURCES}
)

# The UI uses both same-directory ("washing_machine_gen.h") and root-relative
# ("components/base/card/card_gen.h") includes, so the ui/ root is enough.
target_include_directories(app PRIVATE ${UI_DIR})

# Zephyr's LVGL module adds ${LVGL_DIR}/src/ to the include path (where both
# lvgl.h and lvgl_private.h live), but does NOT add ${LVGL_DIR}/ itself.
# The vendored UI headers include either "lvgl.h" or "lvgl/lvgl.h" depending
# on this guard — setting it picks the flat form that matches what's reachable.
target_compile_definitions(app PRIVATE LV_LVGL_H_INCLUDE_SIMPLE)
```

## sample.yaml
```
sample:
  name: TI MSPM0 LVGL Washing Machine
  description: >
    A four-screen LVGL 9 washing-machine UI (home / cycle / setup / service)
    vendored from the lvgl-services ti-washing-machine demo, running on a 320x480
    ST7796S + GT911 panel via the waveshare_3_5_rpi_lcd_f shield.
tests:
  sample.display.ti_washing_machine:
    harness: shield
    platform_allow:
      - lp_mspm0g3519
    depends_on:
      - display
      - i2c
    extra_args:
      - SHIELD=waveshare_3_5_rpi_lcd_f
    tags:
      - display
      - lvgl
```

## prj.conf
```kconfig
# SPDX-License-Identifier: Apache-2.0

CONFIG_DISPLAY=y
CONFIG_LVGL=y
CONFIG_INPUT=y
CONFIG_LV_Z_POINTER_INPUT=y

# LVGL rendering for this UI is call-stack heavy; 4K overflows the main thread
# (garbage-PC hard fault). Give it room, and enable a software stack canary
# (the M0+ has no MPU) plus thread names so any overflow is reported clearly.
CONFIG_MAIN_STACK_SIZE=12288
CONFIG_STACK_SENTINEL=y
CONFIG_THREAD_NAME=y

# RGB565 to match the ST7796S panel.
CONFIG_LV_COLOR_DEPTH_16=y

# Cortex-M0+ (ARMv6-M) cannot do unaligned loads. LVGL blends RGB565 image data
# with uint16_t/uint32_t reads, so the compiled-in image arrays must be aligned
# or the blender hard-faults. Default is 1 (byte-aligned) -> force 4.
CONFIG_LV_ATTRIBUTE_MEM_ALIGN_SIZE=4

# Subject/observer API and the "simple" theme the UI is authored against.
CONFIG_LV_USE_OBSERVER=y
CONFIG_LV_USE_THEME_SIMPLE=y

# Widgets instantiated by the washing machine UI.
CONFIG_LV_USE_LABEL=y
CONFIG_LV_USE_IMAGE=y
CONFIG_LV_USE_BUTTON=y
CONFIG_LV_USE_ARC=y
CONFIG_LV_USE_SLIDER=y

# The UI ships its own fonts, but LVGL still needs a built-in default font.
CONFIG_LV_FONT_MONTSERRAT_14=y

# Modest system heap; LVGL's own VDB/mem-pool are placed in sram1 by the
# shield's board conf.
CONFIG_HEAP_MEM_POOL_SIZE=4096

# Vendored UI calls lv_obj_set_name_static() which requires LV_USE_OBJ_NAME.
CONFIG_LV_USE_OBJ_NAME=y

CONFIG_LOG=y
CONFIG_LV_Z_POINTER_INPUT_MSGQ_COUNT=64

# Synchronous input: the GT911 poll callback feeds LVGL's own 128-deep pointer
# queue directly, with NO intermediate input-subsystem thread/queue. Avoids
# touch-release events being dropped during long repaints (same reasoning as
# the thermostat sample).
CONFIG_INPUT_MODE_SYNCHRONOUS=y

# Single VDB with inline flush keeps the main loop cycling predictably on this
# single-core M0+ (render -> flush -> service input).
```

## boards/lp_mspm0g3519.overlay
```dts
/*
 * Copyright (c) 2026 Texas Instruments
 *
 * SPDX-License-Identifier: Apache-2.0
 *
 * Landscape overlay for the ti_washing_machine sample on LP-MSPM0G3519 +
 * waveshare_3_5_rpi_lcd_f shield.  The shield default is portrait (320x480,
 * madctl=0x48).  This overlay rotates the ST7796S to landscape (480x320) and
 * maps GT911 touch coordinates onto the rotated frame.
 *
 * MADCTL byte breakdown (same as waveshare_3_5_tft_touch non-F landscape):
 *   MY=1  MX=1  MV=1  ML=0  BGR=1  MH=0  → 0xE8
 *
 * Touch coordinate pipeline
 * ─────────────────────────
 * The FT5336 driver (used on the non-F waveshare shield) implicitly swaps its
 * X/Y when calling input_touchscreen_report_pos — it passes (col=Y_reg, row=X_reg),
 * so INPUT_ABS_X carries the long axis (0..479) and INPUT_ABS_Y the short axis
 * (0..319).  The GT911 driver does NOT swap: it passes (col=X_reg, row=Y_reg),
 * so INPUT_ABS_X = short (0..319) and INPUT_ABS_Y = long (0..479).
 *
 * Consequence: the lvgl-pointer swap-xy that cancels the FT5336 implicit swap
 * must be REMOVED for GT911.  Instead:
 *  • Override GT911 screen-width/height to landscape (480×320) so the inversion
 *    formula (screen_width - x) uses the correct range for each axis.
 *  • Apply invert-x and invert-y in the LVGL pointer to mirror both axes —
 *    this is the same net effect as the non-F shield's double-swap + 2 inverts.
 */

&st7796s_display {
	madctl = <0xE8>;
	width  = <480>;
	height = <320>;
};

&gt911_touch {
	screen-width  = <480>;
	screen-height = <320>;
};

&lvgl_pointer {
	invert-x;
	invert-y;
};
```

## src/main.c
```c
/*
 * Copyright (c) 2026 Texas Instruments
 *
 * SPDX-License-Identifier: Apache-2.0
 *
 * Runs the vendored LVGL "washing machine" UI (see ui/, provenance in README.rst)
 * on a Zephyr display + touch. Zephyr auto-initializes LVGL and registers the
 * display/pointer devices via SYS_INIT (CONFIG_LV_Z_AUTO_INIT), so by the time
 * main() runs lv_init() has already happened and we only have to build the UI
 * and pump lv_timer_handler().
 */

#include <zephyr/device.h>
#include <zephyr/devicetree.h>
#include <zephyr/drivers/display.h>
#include <zephyr/kernel.h>
#include <lvgl.h>

#include "washing_machine.h"

#define LOG_LEVEL CONFIG_LOG_DEFAULT_LEVEL
#include <zephyr/logging/log.h>
LOG_MODULE_REGISTER(app);

int main(void)
{
	const struct device *display_dev = DEVICE_DT_GET(DT_CHOSEN(zephyr_display));
	int ret;

	if (!device_is_ready(display_dev)) {
		LOG_ERR("Display device not ready");
		return 0;
	}

	/* Build the washing machine UI (subjects, screens, logic + simulator) and
	 * load the home screen. Assets are compiled in, so the asset-path
	 * argument is unused on this target. */
	washing_machine_init("A:");

	/* Render one frame, then enable the panel. */
	lv_timer_handler();
	ret = display_blanking_off(display_dev);
	if (ret < 0 && ret != -ENOSYS) {
		LOG_ERR("Failed to turn display blanking off (%d)", ret);
		return 0;
	}

	while (1) {
		uint32_t sleep_ms = lv_timer_handler();

		if (sleep_ms == LV_NO_TIMER_READY) {
			sleep_ms = LV_DEF_REFR_PERIOD;
		}
		k_sleep(K_MSEC(sleep_ms));
	}

	return 0;
}
```
