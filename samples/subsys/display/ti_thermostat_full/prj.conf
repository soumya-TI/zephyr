## CMakeLists.txt
```
# SPDX-License-Identifier: Apache-2.0

cmake_minimum_required(VERSION 3.20.0)

# Default to the Waveshare 3.5" RPi LCD (F) shield so that
# "west build -b lp_mspm0g3519 ." works without an explicit --shield.
if(NOT DEFINED SHIELD)
  set(SHIELD waveshare_3_5_rpi_lcd_f)
endif()

# pool_trim.conf overrides CONFIG_LV_Z_MEM_POOL_SIZE AFTER the shield's
# boards/lp_mspm0g3519.conf (which forces it back to 61440 = 93.75% of sram1).
# OVERLAY_CONFIG is consumed as EXTRA_CONF_FILE, processed last in the Kconfig
# merge order: CONF_FILE → shield_conf_files → EXTRA_CONF_FILE.


find_package(Zephyr REQUIRED HINTS $ENV{ZEPHYR_BASE})
project(ti_thermostat_full)

set(UI_DIR ${CMAKE_CURRENT_SOURCE_DIR}/ui)

# Generated UI source list (file_list_gen.cmake) + hand-written custom sources
# (user_config.cmake).  Both files append to LV_EDITOR_PROJECT_SOURCES using
# ${CMAKE_CURRENT_LIST_DIR}, which resolves to ui/ when included from here.
include(${UI_DIR}/file_list_gen.cmake)
include(${UI_DIR}/user_config.cmake)

target_sources(app PRIVATE
    src/main.c
    src/sensor_monitor.c
    ${LV_EDITOR_PROJECT_SOURCES}
)

# The UI uses both same-directory ("bar_gen.h") and root-relative includes
# ("components/base/bar/bar_gen.h"), so the ui/ root alone is sufficient.
target_include_directories(app PRIVATE ${UI_DIR})

# Zephyr's LVGL module adds ${LVGL_DIR}/src/ to the include path (where both
# lvgl.h and lvgl_private.h live), but does NOT add ${LVGL_DIR}/ itself.
# The vendored UI headers include "lvgl.h" when this guard is set.
target_compile_definitions(app PRIVATE LV_LVGL_H_INCLUDE_SIMPLE)
```

## sample.yaml
```
sample:
  name: TI MSPM0 LVGL Thermostat Full
  description: >
    Four-screen (home, schedule, rooms, insights) LVGL 9.5 thermostat UI
    vendored from lvgl-services/ti-thermostat, trimmed for the LP-MSPM0G3519
    (512 KB flash / 128 KB SRAM) with the Waveshare 3.5" RPi LCD (F) shield.
tests:
  sample.display.ti_thermostat_full:
    harness: console
    platform_allow:
      - lp_mspm0g3519
    tags:
      - display
      - lvgl
```

## prj.conf
```kconfig
# SPDX-License-Identifier: Apache-2.0

CONFIG_DISPLAY=y
CONFIG_LVGL=y
CONFIG_INPUT=y
CONFIG_LV_Z_POINTER_INPUT=y

# LVGL rendering for this UI is call-stack heavy; 4K overflows the main thread
# (garbage-PC hard fault). Give it room, and enable a software stack canary
# (the M0+ has no MPU) plus thread names so any overflow is reported clearly.
CONFIG_MAIN_STACK_SIZE=12288
CONFIG_STACK_SENTINEL=y
CONFIG_THREAD_NAME=y

# RGB565 to match the ST7796S panel.
CONFIG_LV_COLOR_DEPTH_16=y

# Cortex-M0+ (ARMv6-M) cannot do unaligned loads. LVGL blends RGB565 image data
# with uint16_t/uint32_t reads, so the compiled-in image arrays must be aligned
# or the blender hard-faults. Default is 1 (byte-aligned) -> force 4.
CONFIG_LV_ATTRIBUTE_MEM_ALIGN_SIZE=4

# Subject/observer API and the "simple" theme the UI is authored against.
CONFIG_LV_USE_OBSERVER=y
CONFIG_LV_USE_THEME_SIMPLE=y

# Float subjects: subject_now_temp uses lv_subject_init_float() and
# thermostat_logic.c reads it with lv_subject_get_float(). Without this the
# observer comparison between the float "now" temperature and the integer
# "target" setpoint cannot compile. Cortex-M0+ has no FPU; operations are
# done in software by the toolchain's soft-float library.
CONFIG_LV_USE_FLOAT=y
CONFIG_CBPRINTF_FP_SUPPORT=y

# Widgets instantiated by the thermostat UI (home + insights only).
CONFIG_LV_USE_LABEL=y
CONFIG_LV_USE_IMAGE=y
CONFIG_LV_USE_BUTTON=y
# CONFIG_LV_USE_SWITCH removed: row_toggle (rooms screen) was the only user.
CONFIG_LV_USE_ROLLER=y
CONFIG_LV_USE_LINE=y
CONFIG_LV_USE_CHART=y
# CONFIG_LV_USE_BAR removed: bar (row_room, rooms screen) was the only user.
# New in the full demo (not in the alternate):
CONFIG_LV_USE_ARC=y      # dial component uses lv_arc_create()
# CONFIG_LV_USE_SLIDER removed: base/slider wrapper has no callers in home+insights.

# The UI ships its own fonts, but LVGL still needs a built-in default font.
CONFIG_LV_FONT_MONTSERRAT_14=y

# Modest system heap; LVGL's own VDB/mem-pool are placed in sram1 by the
# shield's board conf.
CONFIG_HEAP_MEM_POOL_SIZE=4096

# Vendored UI calls lv_obj_set_name_static() which requires LV_USE_OBJ_NAME.
CONFIG_LV_USE_OBJ_NAME=y

# CONFIG_LOG=y

# LVGL pointer input queue: 32 is amply safe at 30ms GT911 polling (worst-case
# single-frame render enqueues ~10 events; 128 was wasting 6KB of sram0).
CONFIG_LV_Z_POINTER_INPUT_MSGQ_COUNT=32

# Synchronous input (matches the sibling ti_thermostat sample's proven fix): the
# GT911 poll feeds LVGL's pointer queue directly, with no intermediate input
# thread/queue that can overflow during a long dial repaint and drop the touch
# RELEASE (which latches LVGL pressed and blocks nav). The pointer glue coalesces
# each sample to one queue entry on sync, so MSGQ_COUNT=32 is ample.
CONFIG_INPUT_MODE_SYNCHRONOUS=y

# On this single-core M0+, a flush thread + double VDB just adds thread-switch
# overhead and starves the touch/input processing (single blocking SPI, no DMA).
# A single VDB with inline flush keeps the main loop cycling predictably.
```

## pool_trim.conf
```kconfig
# pool_trim.conf — applied via OVERLAY_CONFIG in CMakeLists.txt so it lands
# in EXTRA_CONF_FILE and is processed AFTER the shield's lp_mspm0g3519.conf
# (which otherwise forces CONFIG_LV_Z_MEM_POOL_SIZE back to 61440 = 93.75%).
#
# With only home + insights (rooms + schedule dropped), two screens need at most
# ~20-25 KB of LVGL pool at runtime.  50 KB (78.1% of sram1) leaves >2x
# headroom for style-array growth and transient allocations during screen
# switches, while bringing the static build-time LVGL_BUF metric below 88%.
CONFIG_LV_Z_MEM_POOL_SIZE=51200
```

## src/main.c
```c
/*
 * Copyright (c) 2026 Texas Instruments
 *
 * SPDX-License-Identifier: Apache-2.0
 *
 * Runs the vendored LVGL "ti-thermostat" UI (see ui/, provenance in README.rst)
 * on a Zephyr display + touch. Zephyr auto-initializes LVGL and registers the
 * display/pointer devices via SYS_INIT (CONFIG_LV_Z_AUTO_INIT), so by the time
 * main() runs lv_init() has already happened and we only have to build the UI
 * and pump lv_timer_handler().
 */

#include <zephyr/device.h>
#include <zephyr/devicetree.h>
#include <zephyr/drivers/display.h>
#include <zephyr/kernel.h>
#include <lvgl.h>

#include "ti_thermostat.h"
#include "ti_thermostat_gen.h"
#include "sensor_monitor.h"

#define LOG_LEVEL CONFIG_LOG_DEFAULT_LEVEL
#include <zephyr/logging/log.h>
LOG_MODULE_REGISTER(app);

int main(void)
{
	const struct device *display_dev = DEVICE_DT_GET(DT_CHOSEN(zephyr_display));
	int ret;

	if (!device_is_ready(display_dev)) {
		LOG_ERR("Display device not ready");
		return 0;
	}

	/* Build all screens, wire subjects and the simulator. Assets are compiled
	 * in, so the asset-path argument is unused on this target. */
	ti_thermostat_init("A:");

	/* Initialize sensor monitor AFTER ti_thermostat_init (subjects created) */
	sensor_monitor_init();

	/* Render one frame, then enable the panel. */
	lv_timer_handler();
	ret = display_blanking_off(display_dev);
	if (ret < 0 && ret != -ENOSYS) {
		LOG_ERR("Failed to turn display blanking off (%d)", ret);
		return 0;
	}

	while (1) {
		uint32_t sleep_ms = lv_timer_handler();

		if (sleep_ms == LV_NO_TIMER_READY) {
			sleep_ms = LV_DEF_REFR_PERIOD;
		}

		k_sleep(K_MSEC(sleep_ms));
	}

	return 0;
}
```

## src/sensor_monitor.c
```c
/*
 * Copyright (c) 2026 Texas Instruments
 *
 * SPDX-License-Identifier: Apache-2.0
 */

#include <zephyr/kernel.h>
#include <zephyr/device.h>
#include <zephyr/drivers/sensor.h>
#include <zephyr/drivers/rtc.h>
#include <zephyr/logging/log.h>
#include <lvgl.h>

#include "ti_thermostat.h"
#include "sensor_monitor.h"

LOG_MODULE_REGISTER(sensor_monitor, CONFIG_LOG_DEFAULT_LEVEL);

static const struct device *hdc_dev;
static const struct device *rtc_dev;
static lv_timer_t *sensor_timer;

static void sensor_tick_cb(lv_timer_t *timer)
{
	struct sensor_value temp, humidity;
	struct rtc_time tm;
	char time_str[6];
	int rc;

	LV_UNUSED(timer);

	/* Read HDC2080 temperature/humidity sensor */
	rc = sensor_sample_fetch(hdc_dev);
	if (rc < 0) {
		LOG_WRN("Failed to fetch sensor sample: %d", rc);
		return;
	}

	rc = sensor_channel_get(hdc_dev, SENSOR_CHAN_AMBIENT_TEMP, &temp);
	if (rc < 0) {
		LOG_WRN("Failed to get temperature: %d", rc);
		return;
	}

	rc = sensor_channel_get(hdc_dev, SENSOR_CHAN_HUMIDITY, &humidity);
	if (rc < 0) {
		LOG_WRN("Failed to get humidity: %d", rc);
		return;
	}

	// /* Log raw sensor values for debugging */
	// printk("Raw sensor: temp val1=%d val2=%d (%.2f C), humidity val1=%d val2=%d (%d%%)",
	//         temp.val1, temp.val2, sensor_value_to_float(&temp),
	//         humidity.val1, humidity.val2, (int)(sensor_value_to_double(&humidity) + 0.5));

	float temp_c = sensor_value_to_float(&temp);
	int hum_pct = (int)(sensor_value_to_double(&humidity) + 0.5);

	/* Read RTC time */
	rc = rtc_get_time(rtc_dev, &tm);
	if (rc < 0) {
		LOG_WRN("Failed to get RTC time: %d", rc);
		return;
	}

	snprintf(time_str, sizeof(time_str), "%02d:%02d", tm.tm_hour, tm.tm_min);

	// /* Update LVGL subjects - use int100 for temp to avoid float logging issues */
	// int temp_c_int100 = (int)(temp_c * 100);
	// LOG_INF("Setting subject_now_temp=%d.%02d, humidity=%d, time=%s",
	//         temp_c_int100 / 100, temp_c_int100 % 100, hum_pct, time_str);
	lv_subject_set_float(&subject_now_temp, temp_c);
	lv_subject_set_int(&subject_humidity, hum_pct);
	lv_subject_copy_string(&subject_time, time_str);
}

int sensor_monitor_init(void)
{
	/* Get HDC2080 device - uses ti,hdc2080 compatible */
	hdc_dev = DEVICE_DT_GET_ONE(ti_hdc2080);
	if (!device_is_ready(hdc_dev)) {
		LOG_ERR("HDC2080 device not ready");
		return -ENODEV;
	}

	/* Get RTC device */
	rtc_dev = DEVICE_DT_GET(DT_ALIAS(rtc));
	if (!device_is_ready(rtc_dev)) {
		LOG_ERR("RTC device not ready");
		return -ENODEV;
	}

	/* Create 1-second timer for sensor updates */
	sensor_timer = lv_timer_create(sensor_tick_cb, 1000, NULL);
	if (!sensor_timer) {
		LOG_ERR("Failed to create sensor timer");
		return -ENOMEM;
	}

	LOG_INF("Sensor monitor initialized (HDC2080 + RTC)");
	return 0;
}
```

## src/sensor_monitor.h
```c
/*
 * Copyright (c) 2026 Texas Instruments
 *
 * SPDX-License-Identifier: Apache-2.0
 */

#ifndef SENSOR_MONITOR_H
#define SENSOR_MONITOR_H

#ifdef __cplusplus
extern "C" {
#endif

/**
 * @brief Initialize the sensor monitor
 *
 * Initializes the HDC2080 temperature/humidity sensor and RTC,
 * then creates a periodic LVGL timer to update UI subjects with real data.
 *
 * @return 0 on success, negative error code on failure
 */
int sensor_monitor_init(void);

#ifdef __cplusplus
}
#endif

#endif /* SENSOR_MONITOR_H */
```
