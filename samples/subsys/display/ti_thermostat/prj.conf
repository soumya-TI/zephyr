## CMakeLists.txt
```
# SPDX-License-Identifier: Apache-2.0

cmake_minimum_required(VERSION 3.20.0)

# This sample is built for the Waveshare 3.5" RPi LCD (F) panel, which the
# shield provides (ST7796S display + GT911 touch). Default it so a plain
# "west build -b lp_mspm0g3519 ." works; an explicit --shield still overrides.
if(NOT DEFINED SHIELD)
  set(SHIELD waveshare_3_5_rpi_lcd_f)
endif()

find_package(Zephyr REQUIRED HINTS $ENV{ZEPHYR_BASE})
project(ti_thermostat)

set(UI_DIR ${CMAKE_CURRENT_SOURCE_DIR}/ui)

# Generated UI source list + hand-written custom sources. Both files append to
# LV_EDITOR_PROJECT_SOURCES using ${CMAKE_CURRENT_LIST_DIR}, which resolves to
# ui/ when included from here.
include(${UI_DIR}/file_list_gen.cmake)
include(${UI_DIR}/user_config.cmake)

target_sources(app PRIVATE
	src/main.c
	${LV_EDITOR_PROJECT_SOURCES}
)

# The UI uses both same-directory ("card_gen.h") and root-relative
# ("components/base/card/card_gen.h") includes, so the ui/ root is enough.
target_include_directories(app PRIVATE ${UI_DIR})

# Zephyr's LVGL module adds ${LVGL_DIR}/src/ to the include path (where both
# lvgl.h and lvgl_private.h live), but does NOT add ${LVGL_DIR}/ itself.
# The vendored UI headers include either "lvgl.h" or "lvgl/lvgl.h" depending
# on this guard — setting it picks the flat form that matches what's reachable.
target_compile_definitions(app PRIVATE LV_LVGL_H_INCLUDE_SIMPLE)
```

## sample.yaml
```
sample:
  name: TI MSPM0 LVGL Thermostat
  description: >
    A four-screen LVGL 9.5 smart-thermostat UI (home / climate / insights)
    vendored from the lvgl-services thermostat demo, running on a 320x480
    ST7796S + GT911 panel via the waveshare_3_5_rpi_lcd_f shield.
tests:
  sample.display.ti_thermostat:
    harness: shield
    platform_allow:
      - lp_mspm0g3519
    depends_on:
      - display
      - i2c
    extra_args:
      - SHIELD=waveshare_3_5_rpi_lcd_f
    tags:
      - display
      - lvgl
```

## prj.conf
```kconfig
# SPDX-License-Identifier: Apache-2.0

CONFIG_DISPLAY=y
CONFIG_LVGL=y
CONFIG_INPUT=y
CONFIG_LV_Z_POINTER_INPUT=y

# LVGL rendering for this UI is call-stack heavy; 4K overflows the main thread
# (garbage-PC hard fault). Give it room, and enable a software stack canary
# (the M0+ has no MPU) plus thread names so any overflow is reported clearly.
CONFIG_MAIN_STACK_SIZE=16384
CONFIG_STACK_SENTINEL=y
CONFIG_THREAD_NAME=y

# RGB565 to match the ST7796S panel.
CONFIG_LV_COLOR_DEPTH_16=y

# Cortex-M0+ (ARMv6-M) cannot do unaligned loads. LVGL blends RGB565 image data
# with uint16_t/uint32_t reads, so the compiled-in image arrays must be aligned
# or the blender hard-faults. Default is 1 (byte-aligned) -> force 4.
CONFIG_LV_ATTRIBUTE_MEM_ALIGN_SIZE=4

# Subject/observer API and the "simple" theme the UI is authored against.
CONFIG_LV_USE_OBSERVER=y
CONFIG_LV_USE_THEME_SIMPLE=y

# Widgets instantiated by the thermostat UI.
CONFIG_LV_USE_LABEL=y
CONFIG_LV_USE_IMAGE=y
CONFIG_LV_USE_BUTTON=y
CONFIG_LV_USE_SWITCH=y
CONFIG_LV_USE_ROLLER=y
CONFIG_LV_USE_LINE=y
CONFIG_LV_USE_CHART=y
CONFIG_LV_USE_BAR=y

# The UI ships its own fonts, but LVGL still needs a built-in default font.
CONFIG_LV_FONT_MONTSERRAT_14=y

# Modest system heap; LVGL's own VDB/mem-pool are placed in sram1 by the
# shield's board conf.
CONFIG_HEAP_MEM_POOL_SIZE=4096

# Vendored UI calls lv_obj_set_name_static() which requires LV_USE_OBJ_NAME.
CONFIG_LV_USE_OBJ_NAME=y

CONFIG_LOG=y
CONFIG_LV_Z_POINTER_INPUT_MSGQ_COUNT=128

# Synchronous input: the GT911 poll callback feeds LVGL's own 128-deep pointer
# queue directly, with NO intermediate input-subsystem thread/queue. In THREAD
# mode that intermediate queue (even widened) overflowed during a long full-screen
# bar repaint - the input thread is the same priority as the render thread, so it
# starved for the ~330ms of a big drag redraw and dropped events. The dropped one
# was often the touch RELEASE, which left LVGL latched in the pressed state
# (idle_ms stuck at 0, fps healthy) and blocked every subsequent nav tap. In
# synchronous mode a stall backs up only a handful of samples into the 128-deep
# LVGL queue, so the release is never dropped and the press clears on the next
# frame. Removes the "Event dropped, queue full, not blocking in syswq" storm.
CONFIG_INPUT_MODE_SYNCHRONOUS=y

# On this single-core M0+, a flush thread + double VDB just adds thread-switch
# overhead and starves the touch/input processing (single blocking SPI, no DMA).
# A single VDB with inline flush keeps the main loop cycling predictably
# (render -> flush -> service input). Screen transitions are instant (the nav
# buttons' fade animation was removed in screens/*_gen.c), which removes the
# expensive full-screen re-blend that was the worst offender.
```

## src/main.c
```c
/*
 * Copyright (c) 2026 Texas Instruments
 *
 * SPDX-License-Identifier: Apache-2.0
 *
 * Runs the vendored LVGL "thermostat" UI (see ui/, provenance in README.rst)
 * on a Zephyr display + touch. Zephyr auto-initializes LVGL and registers the
 * display/pointer devices via SYS_INIT (CONFIG_LV_Z_AUTO_INIT), so by the time
 * main() runs lv_init() has already happened and we only have to build the UI
 * and pump lv_timer_handler().
 */

#include <zephyr/device.h>
#include <zephyr/devicetree.h>
#include <zephyr/drivers/display.h>
#include <zephyr/kernel.h>
#include <lvgl.h>

#include "thermostat.h"

#define LOG_LEVEL CONFIG_LOG_DEFAULT_LEVEL
#include <zephyr/logging/log.h>
LOG_MODULE_REGISTER(app);

int main(void)
{
	const struct device *display_dev = DEVICE_DT_GET(DT_CHOSEN(zephyr_display));
	int ret;

	if (!device_is_ready(display_dev)) {
		LOG_ERR("Display device not ready");
		return 0;
	}

	/* Build the thermostat UI (subjects, screens, logic + simulator) and
	 * load the home screen. Assets are compiled in, so the asset-path
	 * argument is unused on this target. */
	thermostat_init("A:");

	/* Render one frame, then enable the panel. */
	lv_timer_handler();
	ret = display_blanking_off(display_dev);
	if (ret < 0 && ret != -ENOSYS) {
		LOG_ERR("Failed to turn display blanking off (%d)", ret);
		return 0;
	}

	while (1) {
		uint32_t sleep_ms = lv_timer_handler();

		if (sleep_ms == LV_NO_TIMER_READY) {
			sleep_ms = LV_DEF_REFR_PERIOD;
		}
		k_sleep(K_MSEC(sleep_ms));
	}

	return 0;
}
```
