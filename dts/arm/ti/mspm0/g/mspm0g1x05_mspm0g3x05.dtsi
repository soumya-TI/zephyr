/*
 * Copyright (c) 2026 Texas Instruments
 *
 * SPDX-License-Identifier: Apache-2.0
 */

#include <mem.h>

/delete-node/ &sram0;

/ {
	soc {
		sram0: memory@20200000 {
			reg = <0x20200000 DT_SIZE_K(16)>;
		};
	};
};

&flash0 {
	reg = <0x0 DT_SIZE_K(32)>;
};
