/*
 * Copyright (c) 2026 Texas Instruments
 * Copyright (c) 2026 Linumiz
 *
 * SPDX-License-Identifier: Apache-2.0
 */

#include <mem.h>
#include <ti/mspm0/g/mspm0g310x.dtsi>
#include <ti/mspm0/g/mspm0g1x06_mspm0g3x06.dtsi>